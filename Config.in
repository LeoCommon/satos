## Config.in
```kconfig
# This file contains all packages that that should be 
# "selectablable" from within buildroots config menu

source "$BR2_EXTERNAL_SATOS_PATH/package/gr-iridium/Config.in"
source "$BR2_EXTERNAL_SATOS_PATH/package/leocommon-client/Config.in"
source "$BR2_EXTERNAL_SATOS_PATH/package/rauc-hawkbit-updater/Config.in"
source "$BR2_EXTERNAL_SATOS_PATH/package/satos-genconf/Config.in"
source "$BR2_EXTERNAL_SATOS_PATH/package/fake-hwclock/Config.in"
source "$BR2_EXTERNAL_SATOS_PATH/package/soapysdr/Config.in"
source "$BR2_EXTERNAL_SATOS_PATH/package/soapysdr-uhd/Config.in"
source "$BR2_EXTERNAL_SATOS_PATH/package/soapysdr-hackrf/Config.in"
source "$BR2_EXTERNAL_SATOS_PATH/package/satiq/Config.in"
```

## configs/rpi3_64_defconfig
```kconfig
BR2_aarch64=y
BR2_ARM_FPU_VFPV4=y
BR2_CCACHE=y
BR2_OPTIMIZE_3=y
BR2_GLOBAL_PATCH_DIR="$(BR2_EXTERNAL_SATOS_PATH)/board/common/patches"
BR2_TOOLCHAIN_BUILDROOT_GLIBC=y
BR2_PACKAGE_HOST_LINUX_HEADERS_CUSTOM_5_15=y
BR2_TOOLCHAIN_BUILDROOT_CXX=y
BR2_TOOLCHAIN_BUILDROOT_FORTRAN=y
BR2_GCC_ENABLE_LTO=y
BR2_GCC_ENABLE_OPENMP=y
BR2_PACKAGE_HOST_GDB=y
BR2_TARGET_GENERIC_HOSTNAME="discosatspy"
BR2_TARGET_GENERIC_ISSUE="Welcome to DiscoSAT"
BR2_INIT_SYSTEMD=y
BR2_ROOTFS_DEVICE_TABLE="system/device_table.txt $(BR2_EXTERNAL_SATOS_PATH)/board/common/device_table.txt"
BR2_ROOTFS_DEVICE_TABLE_SUPPORTS_EXTENDED_ATTRIBUTES=y
# BR2_TARGET_GENERIC_REMOUNT_ROOTFS_RW is not set
BR2_SYSTEM_DHCP="eth0"
BR2_SYSTEM_DEFAULT_PATH="/bin:/sbin:/usr/bin:/usr/sbin"
BR2_ROOTFS_OVERLAY="$(BR2_EXTERNAL_SATOS_PATH)/board/common/rootfs-overlay/ $(BR2_EXTERNAL_SATOS_PATH)/board/raspberrypi/rpi3-64/rootfs-overlay/"
BR2_ROOTFS_POST_BUILD_SCRIPT="$(BR2_EXTERNAL_SATOS_PATH)/scripts/post-build.sh $(BR2_EXTERNAL_SATOS_PATH)/board/raspberrypi/rpi3-64/post-build.sh"
BR2_ROOTFS_POST_IMAGE_SCRIPT="$(BR2_EXTERNAL_SATOS_PATH)/board/raspberrypi/rpi3-64/post-image.sh $(BR2_EXTERNAL_SATOS_PATH)/scripts/post-image.sh"
BR2_ROOTFS_POST_SCRIPT_ARGS="$(BR2_EXTERNAL_SATOS_PATH)/board/raspberrypi/rpi3-64/"
BR2_LINUX_KERNEL=y
BR2_LINUX_KERNEL_CUSTOM_TARBALL=y
BR2_LINUX_KERNEL_CUSTOM_TARBALL_LOCATION="$(call github,raspberrypi,linux,0efbe86e7248ad9b80a42b37a91c44860f91eee4)/linux-0efbe86e7248ad9b80a42b37a91c44860f91eee4.tar.gz"
BR2_LINUX_KERNEL_DEFCONFIG="bcmrpi3"
BR2_LINUX_KERNEL_CONFIG_FRAGMENT_FILES="$(BR2_EXTERNAL_SATOS_PATH)/board/raspberrypi/linux.fragment"
BR2_LINUX_KERNEL_DTS_SUPPORT=y
BR2_LINUX_KERNEL_INTREE_DTS_NAME="broadcom/bcm2710-rpi-3-b broadcom/bcm2710-rpi-3-b-plus broadcom/bcm2837-rpi-3-b"
BR2_LINUX_KERNEL_INSTALL_TARGET=y
BR2_LINUX_KERNEL_NEEDS_HOST_OPENSSL=y
BR2_PACKAGE_BUSYBOX_CONFIG_FRAGMENT_FILES="$(BR2_EXTERNAL_SATOS_PATH)/board/common/busybox.fragment"
BR2_PACKAGE_BRCMFMAC_SDIO_FIRMWARE_RPI=y
BR2_PACKAGE_BRCMFMAC_SDIO_FIRMWARE_RPI_WIFI=y
BR2_PACKAGE_RPI_FIRMWARE=y
BR2_PACKAGE_RPI_FIRMWARE_BOOTCODE_BIN=y
BR2_PACKAGE_RPI_FIRMWARE_VARIANT_PI_CD=y
BR2_PACKAGE_RPI_FIRMWARE_CONFIG_FILE="$(BR2_EXTERNAL_SATOS_PATH)/board/raspberrypi/rpi3-64/config_fw.txt"
BR2_PACKAGE_GPSD=y
BR2_PACKAGE_GPSD_DEVICES="/dev/ttyUSB1"
BR2_PACKAGE_USBMOUNT=y
BR2_PACKAGE_PYTHON3=y
BR2_PACKAGE_PYTHON3_BZIP2=y
BR2_PACKAGE_PYTHON3_XZ=y
BR2_PACKAGE_PYTHON3_ZLIB=y
BR2_PACKAGE_HACKRF=y
BR2_PACKAGE_ORC=y
BR2_PACKAGE_NEWT=y
BR2_PACKAGE_READLINE=y
BR2_PACKAGE_GNURADIO=y
BR2_PACKAGE_GNURADIO_PYTHON=y
BR2_PACKAGE_GNURADIO_UTILS=y
BR2_PACKAGE_GR_OSMOSDR=y
BR2_PACKAGE_GR_OSMOSDR_PYTHON=y
BR2_PACKAGE_GR_OSMOSDR_RTLSDR=y
BR2_PACKAGE_GR_OSMOSDR_HACKRF=y
BR2_PACKAGE_CHRONY=y
BR2_PACKAGE_DHCP=y
BR2_PACKAGE_DHCP_CLIENT=y
BR2_PACKAGE_MODEM_MANAGER_LIBQMI=y
BR2_PACKAGE_NETWORK_MANAGER=y
BR2_PACKAGE_NETWORK_MANAGER_MODEM_MANAGER=y
BR2_PACKAGE_UQMI=y
BR2_PACKAGE_WGET=y
BR2_PACKAGE_WIREGUARD_TOOLS=y
BR2_PACKAGE_WIRELESS_REGDB=y
BR2_PACKAGE_WPA_SUPPLICANT=y
BR2_PACKAGE_WPA_SUPPLICANT_WPA3=y
BR2_PACKAGE_RAUC=y
BR2_PACKAGE_RAUC_DBUS=y
# BR2_PACKAGE_SYSTEMD_TIMESYNCD is not set
BR2_TARGET_ROOTFS_EXT2=y
BR2_TARGET_ROOTFS_EXT2_4=y
BR2_TARGET_ROOTFS_EXT2_SIZE="512M"
# BR2_TARGET_ROOTFS_TAR is not set
BR2_TARGET_UBOOT=y
BR2_TARGET_UBOOT_BOARD_DEFCONFIG="rpi_arm64"
BR2_TARGET_UBOOT_CONFIG_FRAGMENT_FILES="$(BR2_EXTERNAL_SATOS_PATH)/board/raspberrypi/uboot.fragment"
BR2_PACKAGE_HOST_DOSFSTOOLS=y
BR2_PACKAGE_HOST_GENIMAGE=y
BR2_PACKAGE_HOST_MTOOLS=y
BR2_PACKAGE_HOST_RAUC=y
BR2_PACKAGE_HOST_UBOOT_TOOLS=y
BR2_PACKAGE_HOST_UBOOT_TOOLS_BOOT_SCRIPT=y
BR2_PACKAGE_HOST_UBOOT_TOOLS_BOOT_SCRIPT_SOURCE="$(BR2_EXTERNAL_SATOS_PATH)/board/raspberrypi/uboot.ush"
BR2_PACKAGE_PYTHON_SCIPY=y
BR2_PACKAGE_GR_IRIDIUM=y
BR2_PACKAGE_GR_IRIDIUM_PYTHON=y
BR2_PACKAGE_DISCO_APOGEE=y
```

## package/apogee/Config.in
```kconfig
config BR2_PACKAGE_APOGEE
	bool "apogee"
	depends on BR2_PACKAGE_HOST_GO_TARGET_ARCH_SUPPORTS
	depends on BR2_TOOLCHAIN_HAS_THREADS
	select BR2_PACKAGE_HOST_GO
	select BR2_PACKAGE_LIBUSB
	help
	  System and task management daemons for satos

	  https://git.cs.uni-kl.de/discosat/apogee
```

## package/disco-apogee/Config.in
```kconfig
config BR2_PACKAGE_DISCO_APOGEE
	bool "disco-apogee"
	depends on BR2_PACKAGE_HOST_GO_TARGET_ARCH_SUPPORTS
	depends on BR2_PACKAGE_HOST_GO
	help
	  System and task management daemons for satos

	  https://git.cs.uni-kl.de/discosat/apogee
```

## package/fake-hwclock/Config.in
```kconfig
config BR2_PACKAGE_FAKE_HWCLOCK
	bool "fake-hwclock"
	depends on BR2_INIT_SYSTEMD
	help
     Helper systemd scripts to ensure (mostly) forward moving time.

comment "fake-hwclock requires the systemd init system"
	depends on !BR2_INIT_SYSTEMD
```

## package/gr-iridium/Config.in
```kconfig
config BR2_PACKAGE_GR_IRIDIUM
	bool "gr-iridium"
	depends on BR2_PACKAGE_GNURADIO
	select BR2_PACKAGE_GNURADIO_BLOCKS
	select BR2_PACKAGE_GNURADIO_FFT
	select BR2_PACKAGE_GNURADIO_FILTER
	select BR2_PACKAGE_VOLK
	help
	  Module providing blocks to build an Iridium burst detector and demodulator.

	  https://git.cs.uni-kl.de/ej_research/discosat/discosat_gr_iridium

if BR2_PACKAGE_GR_IRIDIUM

config BR2_PACKAGE_GR_IRIDIUM_PYTHON
	bool "python support"
	depends on BR2_PACKAGE_GNURADIO_PYTHON
	depends on BR2_PACKAGE_PYTHON3
	select BR2_PACKAGE_PYTHON_SCIPY
	help
	  Enable Python support

endif
```

## package/leocommon-client/Config.in
```kconfig
config BR2_PACKAGE_LEOCOMMON_CLIENT
	bool "leocommonclient"
	depends on BR2_PACKAGE_HOST_GO_TARGET_ARCH_SUPPORTS
	depends on BR2_TOOLCHAIN_HAS_THREADS
	select BR2_PACKAGE_HOST_GO
	select BR2_PACKAGE_LIBUSB
	help
	  System and task management daemons for satos

	  https://github.com/leocommon/client
```

## package/libad9361/Config.in
```kconfig
config BR2_PACKAGE_LIBAD9361
	bool "libad9361"
	depends on BR2_PACKAGE_LIBIIO
	help
	  https://github.com/analogdevicesinc/libad9361-iio/
```

## package/libvolk/Config.in
```kconfig
config BR2_PACKAGE_LIBVOLK
	bool "libvolk"
	depends on BR2_TOOLCHAIN_SUPPORTS_ALWAYS_LOCKFREE_ATOMIC_INTS # boost-filesystem
	depends on BR2_USE_WCHAR
	select BR2_PACKAGE_BOOST
	select BR2_PACKAGE_BOOST_SYSTEM
	select BR2_PACKAGE_BOOST_FILESYSTEM
	select BR2_PACKAGE_LIBEVENT
	help
	  VOLK is the Vector-Optimized Library of Kernels. 
	  It is a library that contains kernels of hand-written SIMD code 
	  for different mathematical operations. Since each SIMD 
	  architecture can be very different and no compiler has yet come 
	  along to handle vectorization properly or highly efficiently,
	  VOLK approaches the problem differently.

	  https://github.com/gnuradio/volk

comment "libvolk needs a toolchain w/ wchar"
	depends on !BR2_USE_WCHAR
```

## package/python-dotenv/Config.in
```kconfig
config BR2_PACKAGE_PYTHON_DOTENV
	bool "python-dotenv"
	depends on BR2_PACKAGE_PYTHON3
	help
	  Read key-value pairs from a .env file and set them as environment variables

	  https://pypi.org/project/python-dotenv/
```

## package/python-scipy/Config.in
```kconfig
config BR2_PACKAGE_PYTHON_SCIPY
	bool "python-scipy"
	depends on BR2_PACKAGE_OPENBLAS_ARCH_SUPPORTS # for openblas
	depends on BR2_PACKAGE_PYTHON_NUMPY_ARCH_SUPPORTS # for python-numpy
	depends on BR2_TOOLCHAIN_HAS_FORTRAN # lapack
	depends on BR2_PACKAGE_LAPACK_ARCH_SUPPORTS # lapack
	depends on BR2_TOOLCHAIN_USES_GLIBC || BR2_TOOLCHAIN_USES_MUSL # for python-numpy
	depends on BR2_INSTALL_LIBSTDCPP
	depends on BR2_PACKAGE_PYTHON3
	select BR2_PACKAGE_OPENBLAS # build
	select BR2_PACKAGE_LAPACK # build
	select BR2_PACKAGE_PYTHON_NUMPY # runtime
	select BR2_PACKAGE_PYTHON_PYBIND

	help
	  SciPy (pronounced "Sigh Pie") is an open-source software for mathematics, science, and engineering.
	  It includes modules for statistics, optimization, integration, linear algebra, 
	  Fourier transforms, signal and image processing, ODE solvers, and more.

	  https://www.scipy.org/


comment "python-scipy needs python-numpy"
	depends on !BR2_PACKAGE_PYTHON_NUMPY_ARCH_SUPPORTS

comment "python-scipy needs fortran"
	depends on !BR2_TOOLCHAIN_HAS_FORTRAN

comment "python-scipy needs openblas"
	depends on !BR2_PACKAGE_OPENBLAS_ARCH_SUPPORTS
```

## package/rauc-hawkbit-updater/Config.in
```kconfig
config BR2_PACKAGE_RAUC_HAWKBIT_UPDATER
	bool "rauc-hawkbit-updater"
	depends on BR2_PACKAGE_RAUC
	select BR2_PACKAGE_RAUC_JSON
	select BR2_PACKAGE_RAUC_NETWORK
	help
	  The RAUC hawkBit updater is a simple commandline tool / daemon written in C (glib). 
	  It is a port of the RAUC hawkBit Client written in Python. 
	  The daemon runs on your target and operates as an interface between the RAUC D-Bus API and the hawkBit DDI API.

	  https://github.com/rauc/rauc-hawkbit-updater
```

## package/satiq/Config.in
```kconfig
config BR2_PACKAGE_SATIQ
	bool "satiq"
	depends on BR2_PACKAGE_PYTHON3
	select BR2_PACKAGE_PYTHON_CRCMOD
	select BR2_PACKAGE_PYTHON_NUMPY
	select BR2_PACKAGE_PYTHON_PYZMQ
	help
	  Data collection code from the SATIQ System, modified for portability.
```

## package/satos-genconf/Config.in
```kconfig
config BR2_PACKAGE_SATOS_GENCONF
	bool "satos-genconf"
	depends on BR2_PACKAGE_PYTHON3
	select BR2_PACKAGE_PYTHON_DOTENV
	select BR2_PACKAGE_PYTHON_JINJA2
	help
	  Tool for automatically generating config files for certain services like the rauc-hawkbit updater.

	  https://github.com/LeoCommon/satos_genconf
```

## package/soapysdr-hackrf/Config.in
```kconfig
config BR2_PACKAGE_SOAPYSDR_HACKRF
	bool "soapysdr-hackrf"
	depends on !BR2_STATIC_LIBS
	depends on BR2_TOOLCHAIN_HAS_THREADS
	depends on BR2_PACKAGE_SOAPYSDR
	depends on BR2_PACKAGE_HACKRF
	select BR2_PACKAGE_BOOST_THREAD
	select BR2_PACKAGE_BOOST_SYSTEM
	help
	  Soapy SDR plugins for HACKRF supported SDR devices

	  https://github.com/pothosware/SoapyHackRF

comment "soapysdr-hackrf needs a toolchain w/ threads, dynamic library, gcc >= 4.9"
	depends on BR2_STATIC_LIBS || !BR2_TOOLCHAIN_HAS_THREADS || \
		!BR2_TOOLCHAIN_GCC_AT_LEAST_4_9
```

## package/soapysdr-lime/Config.in
```kconfig
config BR2_PACKAGE_SOAPYSDR_LIME
	bool "soapysdr-lime"
	depends on !BR2_STATIC_LIBS
	depends on BR2_TOOLCHAIN_HAS_THREADS
	depends on BR2_PACKAGE_SOAPYSDR
	depends on BR2_TOOLCHAIN_GCC_AT_LEAST_4_9 # libusb
	select BR2_PACKAGE_LIBUSB
	select BR2_PACKAGE_BOOST_THREAD
	select BR2_PACKAGE_BOOST_SYSTEM
	
	help
	  Soapy SDR plugins for LIME supported SDR devices

	  https://github.com/myriadrf/LimeSuiteNG/

comment "soapysdr-lime needs a toolchain w/ threads, dynamic library, gcc >= 4.9"
	depends on BR2_STATIC_LIBS || !BR2_TOOLCHAIN_HAS_THREADS || \
		!BR2_TOOLCHAIN_GCC_AT_LEAST_4_9
```

## package/soapysdr-pluto/Config.in
```kconfig
config BR2_PACKAGE_SOAPYSDR_PLUTO
	bool "soapysdr-pluto"
	depends on !BR2_STATIC_LIBS
	depends on BR2_TOOLCHAIN_HAS_THREADS
	depends on BR2_PACKAGE_SOAPYSDR
	select BR2_PACKAGE_LIBIIO
	select BR2_PACKAGE_LIBAD9361
	help
	  Soapy SDR plugins for RTLSDR supported SDR devices

	  https://github.com/pothosware/SoapyRTLSDR

comment "soapysdr-rtlsdr needs a toolchain w/ threads, dynamic library, gcc >= 4.9"
	depends on BR2_STATIC_LIBS || !BR2_TOOLCHAIN_HAS_THREADS || \
		!BR2_TOOLCHAIN_GCC_AT_LEAST_4_9
```

## package/soapysdr-uhd/Config.in
```kconfig
config BR2_PACKAGE_SOAPYSDR_UHD
	bool "soapysdr-uhd"
	depends on !BR2_STATIC_LIBS
	depends on BR2_TOOLCHAIN_HAS_THREADS
	depends on BR2_PACKAGE_SOAPYSDR
	depends on BR2_PACKAGE_UHD
	select BR2_PACKAGE_BOOST_THREAD
	select BR2_PACKAGE_BOOST_SYSTEM
	help
	  Soapy SDR plugins for UHD supported SDR devices

	  https://github.com/pothosware/SoapyUHD

comment "soapysdr-uhd needs a toolchain w/ threads, dynamic library, gcc >= 4.9"
	depends on BR2_STATIC_LIBS || !BR2_TOOLCHAIN_HAS_THREADS || \
		!BR2_TOOLCHAIN_GCC_AT_LEAST_4_9
```

## package/soapysdr/Config.in
```kconfig
config BR2_PACKAGE_SOAPYSDR
	bool "soapysdr"
	depends on !BR2_STATIC_LIBS
	depends on BR2_TOOLCHAIN_HAS_THREADS
	depends on BR2_PACKAGE_PYTHON_NUMPY
	help
	  Soapy SDR - vendor and platform neutral SDR support library.

	  https://github.com/pothosware/SoapySDR/

comment "soapysdr needs a toolchain w/ threads, dynamic library, gcc >= 4.9"
	depends on BR2_STATIC_LIBS || !BR2_TOOLCHAIN_HAS_THREADS || \
		!BR2_TOOLCHAIN_GCC_AT_LEAST_4_9
```

## package/uhd-firmware/Config.in
```kconfig
config BR2_PACKAGE_UHD_FIRMWARE
	bool "uhd-firmware"
	depends on BR2_PACKAGE_UHD
	help
	  Firmware images for Universal Software Radio Peripheral (USRP)
	  Hardware Driver devices.
	  
	  https://github.com/EttusResearch/uhd
```

## package/volk/Config.in
```kconfig
config BR2_PACKAGE_VOLK
	bool "volk"
	depends on BR2_TOOLCHAIN_SUPPORTS_ALWAYS_LOCKFREE_ATOMIC_INTS
	depends on BR2_USE_WCHAR
	select BR2_PACKAGE_LIBEVENT
	help
	  VOLK is the Vector-Optimized Library of Kernels. 
	  It is a library that contains kernels of hand-written SIMD code 
	  for different mathematical operations. Since each SIMD 
	  architecture can be very different and no compiler has yet come 
	  along to handle vectorization properly or highly efficiently,
	  VOLK approaches the problem differently.

	  https://github.com/gnuradio/volk

comment "volk needs a toolchain w/ wchar"
	depends on !BR2_USE_WCHAR
```
